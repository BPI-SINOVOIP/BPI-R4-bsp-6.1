// SPDX-License-Identifier: GPL-2.0
/*
 * Copyright (c) 2022 MediaTek Inc.
 * Author: Sam Shih <sam.shih@mediatek.com>
 */

/dts-v1/;
#include "mt7988a-bananapi-bpi-r4.dtsi"

&mmc0 {
	pinctrl-names = "default";
	pinctrl-0 = <&mmc1_pins_default>;
	max-frequency = <52000000>;
	bus-width = <4>;
	cap-sd-highspeed;
	vmmc-supply = <&reg_3p3v>;
	vqmmc-supply = <&reg_3p3v>;
	status = "okay";
};
