## u-boot-mt/board/ravpower/rp-wd009/Kconfig
```kconfig
if BOARD_RAVPOWER_RP_WD009

config SYS_BOARD
	default "rp-wd009"

config SYS_VENDOR
	default "ravpower"

config SYS_CONFIG_NAME
	default "ravpower-rp-wd009"

endif
```

## u-boot-mt/configs/mt7622_linksys_e8450_defconfig
```kconfig
CONFIG_ARM=y
CONFIG_POSITION_INDEPENDENT=y
CONFIG_ARCH_MEDIATEK=y
CONFIG_TARGET_MT7622=y
CONFIG_TEXT_BASE=0x41e00000
CONFIG_SYS_MALLOC_F_LEN=0x4000
CONFIG_SYS_LOAD_ADDR=0x40080000
CONFIG_USE_DEFAULT_ENV_FILE=y
CONFIG_BOARD_LATE_INIT=y
CONFIG_BOOTP_SEND_HOSTNAME=y
CONFIG_DEFAULT_ENV_FILE="linksys_e8450_env"
CONFIG_NR_DRAM_BANKS=1
CONFIG_DEBUG_UART_BASE=0x11002000
CONFIG_DEBUG_UART_CLOCK=25000000
CONFIG_DEFAULT_DEVICE_TREE="mt7622-linksys-e8450-ubi"
CONFIG_DEBUG_UART=y
CONFIG_MTDPARTS_DEFAULT="mtdparts=spi-nand0:512k(bl2),1280k(fip),1024k(factory),256k(reserved),-(ubi)"
CONFIG_SMBIOS_PRODUCT_NAME=""
CONFIG_AUTOBOOT_KEYED=y
CONFIG_BOOTDELAY=30
CONFIG_AUTOBOOT_MENU_SHOW=y
CONFIG_CFB_CONSOLE_ANSI=y
CONFIG_BUTTON=y
CONFIG_BUTTON_GPIO=y
CONFIG_GPIO_HOG=y
CONFIG_CMD_ENV_FLAGS=y
CONFIG_FIT=y
CONFIG_FIT_ENABLE_SHA256_SUPPORT=y
CONFIG_LED=y
CONFIG_LED_BLINK=y
CONFIG_LED_GPIO=y
CONFIG_LOGLEVEL=7
CONFIG_LOG=y
CONFIG_DEFAULT_FDT_FILE="mt7622-linksys-e8450"
CONFIG_SYS_PROMPT="MT7622> "
CONFIG_CMD_BOOTMENU=y
CONFIG_CMD_BOOTP=y
CONFIG_CMD_BUTTON=y
CONFIG_CMD_CDP=y
CONFIG_CMD_DHCP=y
CONFIG_CMD_DNS=y
CONFIG_CMD_ECHO=y
CONFIG_CMD_ENV_READMEM=y
CONFIG_CMD_ERASEENV=y
CONFIG_CMD_EXT4=y
CONFIG_CMD_FAT=y
CONFIG_CMD_FS_GENERIC=y
CONFIG_CMD_FS_UUID=y
CONFIG_CMD_GPIO=y
CONFIG_CMD_GPT=y
CONFIG_CMD_HASH=y
CONFIG_CMD_ITEST=y
CONFIG_CMD_LED=y
CONFIG_CMD_LICENSE=y
CONFIG_CMD_LINK_LOCAL=y
# CONFIG_CMD_MBR is not set
CONFIG_CMD_MTD=y
CONFIG_CMD_MTDPARTS=y
CONFIG_CMD_PCI=y
CONFIG_CMD_SF_TEST=y
CONFIG_CMD_PING=y
CONFIG_CMD_PXE=y
CONFIG_CMD_SMC=y
CONFIG_CMD_TFTPBOOT=y
CONFIG_CMD_TFTPSRV=y
CONFIG_CMD_UBI=y
CONFIG_CMD_UBI_RENAME=y
CONFIG_CMD_UBIFS=y
CONFIG_CMD_ASKENV=y
CONFIG_CMD_PART=y
CONFIG_CMD_PSTORE=y
CONFIG_CMD_PSTORE_MEM_ADDR=0x42ff0000
CONFIG_CMD_RARP=y
CONFIG_CMD_SETEXPR=y
CONFIG_CMD_SLEEP=y
CONFIG_CMD_SNTP=y
CONFIG_CMD_SOURCE=y
CONFIG_CMD_USB=y
CONFIG_CMD_UUID=y
CONFIG_DISPLAY_CPUINFO=y
CONFIG_DM_REGULATOR=y
CONFIG_DM_REGULATOR_FIXED=y
CONFIG_DM_REGULATOR_GPIO=y
CONFIG_DM_USB=y
CONFIG_HUSH_PARSER=y
CONFIG_SYS_REDUNDAND_ENVIRONMENT=y
CONFIG_SYS_RELOC_GD_ENV_ADDR=y
CONFIG_ENV_IS_IN_UBI=y
CONFIG_ENV_UBI_PART="ubi"
CONFIG_ENV_UBI_VOLUME="ubootenv"
CONFIG_ENV_UBI_VOLUME_REDUND="ubootenv2"
CONFIG_ENV_VARS_UBOOT_RUNTIME_CONFIG=y
CONFIG_VERSION_VARIABLE=y
CONFIG_PARTITION_UUIDS=y
CONFIG_NETCONSOLE=y
CONFIG_REGMAP=y
CONFIG_SYSCON=y
CONFIG_CLK=y
CONFIG_DM_MTD=y
CONFIG_DM_GPIO=y
CONFIG_PHY=y
CONFIG_PHY_MTK_TPHY=y
CONFIG_PHY_FIXED=y
CONFIG_DM_ETH=y
CONFIG_MEDIATEK_ETH=y
CONFIG_PCI=y
CONFIG_MTD=y
CONFIG_MTD_UBI_FASTMAP=y
CONFIG_DM_PCI=y
CONFIG_PCIE_MEDIATEK=y
CONFIG_PINCTRL=y
CONFIG_PINCONF=y
CONFIG_PINCTRL_MT7622=y
CONFIG_POWER_DOMAIN=y
CONFIG_PRE_CONSOLE_BUFFER=y
CONFIG_PRE_CON_BUF_ADDR=0x4007EF00
CONFIG_MTK_POWER_DOMAIN=y
CONFIG_RAM=y
CONFIG_DM_SERIAL=y
CONFIG_MTK_SERIAL=y
CONFIG_SPI=y
CONFIG_DM_SPI=y
CONFIG_MTK_SPI_NAND=y
CONFIG_MTK_SPI_NAND_MTD=y
CONFIG_SYSRESET_WATCHDOG=y
CONFIG_SYS_HAS_NONCACHED_MEMORY=y
CONFIG_WDT_MTK=y
CONFIG_LZO=y
CONFIG_ZSTD=y
CONFIG_HEXDUMP=y
CONFIG_RANDOM_UUID=y
CONFIG_REGEX=y
CONFIG_USE_IPADDR=y
CONFIG_IPADDR="192.168.1.1"
CONFIG_USE_SERVERIP=y
CONFIG_SERVERIP="192.168.1.254"
CONFIG_USB=y
CONFIG_USB_HOST=y
CONFIG_USB_XHCI_HCD=y
CONFIG_USB_XHCI_MTK=y
CONFIG_USB_STORAGE=y
```

## u-boot-mt/configs/mt7622_ubnt_unifi-6-lr-v3_defconfig
```kconfig
CONFIG_ARM=y
CONFIG_POSITION_INDEPENDENT=y
CONFIG_ARCH_MEDIATEK=y
CONFIG_TARGET_MT7622=y
CONFIG_TEXT_BASE=0x41e00000
CONFIG_SYS_MALLOC_F_LEN=0x4000
CONFIG_SYS_LOAD_ADDR=0x40080000
CONFIG_USE_DEFAULT_ENV_FILE=y
CONFIG_MTDPARTS_DEFAULT="mtdparts=nor0:128k(bl2),640k(fip),64k(u-boot-env),256k(factory),64k(eeprom),15232k(recovery),-(firmware)"
CONFIG_ENV_IS_IN_MTD=y
CONFIG_ENV_MTD_NAME="nor0"
CONFIG_ENV_SIZE_REDUND=0x4000
CONFIG_ENV_SIZE=0x4000
CONFIG_ENV_OFFSET=0xc0000
CONFIG_ENV_VARS_UBOOT_RUNTIME_CONFIG=y
CONFIG_BOARD_LATE_INIT=y
CONFIG_RESET_BUTTON_SETTLE_DELAY=400
CONFIG_BOOTP_SEND_HOSTNAME=y
CONFIG_DEFAULT_ENV_FILE="ubnt_unifi-6-lr_env"
CONFIG_DEBUG_UART_BASE=0x11002000
CONFIG_DEBUG_UART_CLOCK=25000000
CONFIG_DEFAULT_DEVICE_TREE="mt7622-ubnt-unifi-6-lr-v3"
CONFIG_DEBUG_UART=y
CONFIG_SMBIOS_PRODUCT_NAME=""
CONFIG_AUTOBOOT_KEYED=y
CONFIG_BOOTDELAY=30
CONFIG_AUTOBOOT_MENU_SHOW=y
CONFIG_CFB_CONSOLE_ANSI=y
CONFIG_BUTTON=y
CONFIG_BUTTON_GPIO=y
CONFIG_GPIO_HOG=y
CONFIG_CMD_ENV_FLAGS=y
CONFIG_FIT=y
CONFIG_FIT_ENABLE_SHA256_SUPPORT=y
CONFIG_LOGLEVEL=7
CONFIG_LOG=y
CONFIG_DEFAULT_FDT_FILE="mt7622-ubnt-unifi-6-lr-v3"
CONFIG_SYS_PROMPT="MT7622> "
# CONFIG_LEGACY_IMAGE_FORMAT is not set
# CONFIG_BOOTM_PLAN9 is not set
# CONFIG_BOOTM_RTEMS is not set
# CONFIG_BOOTM_VXWORKS is not set
# CONFIG_EFI is not set
# CONFIG_EFI_LOADER is not set
CONFIG_CMD_BOOTMENU=y
# CONFIG_CMD_BOOTEFI is not set
CONFIG_CMD_BOOTP=y
CONFIG_CMD_BUTTON=y
CONFIG_CMD_CDP=y
CONFIG_CMD_DHCP=y
CONFIG_CMD_DNS=y
CONFIG_CMD_ECHO=y
# CONFIG_CMD_ELF is not set
# CONFIG_CMD_BOOTEFI_BOOTMGR is not set
CONFIG_CMD_ENV_READMEM=y
CONFIG_CMD_ERASEENV=y
CONFIG_CMD_GPIO=y
CONFIG_CMD_HASH=y
CONFIG_CMD_ITEST=y
CONFIG_CMD_LED=y
CONFIG_CMD_LINK_LOCAL=y
# CONFIG_CMD_MBR is not set
CONFIG_CMD_MTD=y
CONFIG_CMD_MTDPARTS=y
# CONFIG_CMD_PCI is not set
CONFIG_CMD_SF_TEST=y
CONFIG_CMD_PING=y
CONFIG_CMD_PXE=y
CONFIG_CMD_SMC=y
CONFIG_CMD_TFTPBOOT=y
CONFIG_CMD_TFTPSRV=y
# CONFIG_CMD_UNLZ4 is not set
CONFIG_CMD_ASKENV=y
CONFIG_CMD_PSTORE=y
CONFIG_CMD_PSTORE_MEM_ADDR=0x42ff0000
CONFIG_CMD_RARP=y
CONFIG_CMD_SETEXPR=y
CONFIG_CMD_SLEEP=y
CONFIG_CMD_SOURCE=y
CONFIG_CMD_UUID=y
CONFIG_DISPLAY_CPUINFO=y
CONFIG_DM_ETH=y
CONFIG_DM_ETH_PHY=y
CONFIG_DM_GPIO=y
CONFIG_DM_MDIO=y
CONFIG_DM_MTD=y
CONFIG_DM_REGULATOR=y
CONFIG_DM_REGULATOR_FIXED=y
CONFIG_DM_REGULATOR_GPIO=y
# CONFIG_DM_MMC is not set
CONFIG_DM_SERIAL=y
CONFIG_DM_SPI=y
CONFIG_DM_SPI_FLASH=y
CONFIG_HUSH_PARSER=y
# CONFIG_PARTITION_UUIDS is not set
CONFIG_SYS_RELOC_GD_ENV_ADDR=y
# CONFIG_LED is not set
# CONFIG_LZ4 is not set
CONFIG_VERSION_VARIABLE=y
CONFIG_NETCONSOLE=y
CONFIG_REGMAP=y
CONFIG_SYSCON=y
CONFIG_CLK=y
CONFIG_PHY=y
CONFIG_PHY_FIXED=y
CONFIG_PHY_REALTEK=y
CONFIG_PHY_ADDR_ENABLE=y
CONFIG_PHY_ADDR=0
CONFIG_MEDIATEK_ETH=y
CONFIG_MTD=y
# CONFIG_MMC is not set
CONFIG_PINCTRL=y
CONFIG_PINCONF=y
CONFIG_PINCTRL_MT7622=y
CONFIG_POWER_DOMAIN=y
CONFIG_PRE_CONSOLE_BUFFER=y
CONFIG_PRE_CON_BUF_ADDR=0x4007EF00
CONFIG_MTK_POWER_DOMAIN=y
CONFIG_RAM=y
CONFIG_MTK_SERIAL=y
CONFIG_SPI=y
CONFIG_MTK_SNFI_SPI=y
CONFIG_MTK_SNOR=y
CONFIG_SYSRESET_WATCHDOG=y
CONFIG_WDT_MTK=y
CONFIG_HEXDUMP=y
CONFIG_RANDOM_UUID=y
CONFIG_REGEX=y
CONFIG_SPI_FLASH=y
CONFIG_SPI_FLASH_BAR=y
CONFIG_SPI_FLASH_MTD=y
CONFIG_SPI_FLASH_UNLOCK_ALL=y
CONFIG_SPI_FLASH_EON=y
CONFIG_SPI_FLASH_GIGADEVICE=y
CONFIG_SPI_FLASH_MACRONIX=y
CONFIG_SPI_FLASH_SPANSION=y
CONFIG_SPI_FLASH_STMICRO=y
CONFIG_SPI_FLASH_SST=y
CONFIG_SPI_FLASH_WINBOND=y
CONFIG_SPI_FLASH_XMC=y
CONFIG_SPI_FLASH_USE_4K_SECTORS=y
CONFIG_SYS_HAS_NONCACHED_MEMORY=y
CONFIG_USE_IPADDR=y
CONFIG_IPADDR="192.168.1.1"
CONFIG_USE_SERVERIP=y
CONFIG_SERVERIP="192.168.1.254"
```

## u-boot-mt/configs/mt7623a_unielec_u7623_02_defconfig
```kconfig
CONFIG_ARM=y
CONFIG_SYS_HAS_NONCACHED_MEMORY=y
CONFIG_SYS_THUMB_BUILD=y
CONFIG_ARCH_MEDIATEK=y
CONFIG_TEXT_BASE=0x81e00000
CONFIG_SYS_MALLOC_F_LEN=0x4000
CONFIG_NR_DRAM_BANKS=1
CONFIG_HAS_CUSTOM_SYS_INIT_SP_ADDR=y
CONFIG_CUSTOM_SYS_INIT_SP_ADDR=0x81ffff10
CONFIG_ENV_SIZE=0x10000
CONFIG_ENV_OFFSET=0x100000
CONFIG_DEFAULT_DEVICE_TREE="mt7623a-unielec-u7623-02-emmc"
CONFIG_TARGET_MT7623=y
CONFIG_SYS_LOAD_ADDR=0x84000000
CONFIG_FIT=y
CONFIG_FIT_VERBOSE=y
CONFIG_FIT_ENABLE_SHA256_SUPPORT=y
CONFIG_LED=y
CONFIG_LED_BLINK=y
CONFIG_LED_GPIO=y
CONFIG_LOGLEVEL=7
CONFIG_LOG=y
CONFIG_AUTOBOOT_KEYED=y
CONFIG_AUTOBOOT_MENU_SHOW=y
CONFIG_BOARD_LATE_INIT=y
# CONFIG_BOOTSTD is not set
# CONFIG_BOOT_DEFAULTS is not set
CONFIG_DISTRO_DEFAULTS=y
CONFIG_BOOTDELAY=3
CONFIG_BOOTP_SEND_HOSTNAME=y
CONFIG_DEFAULT_FDT_FILE="mt7623a-unielec-u7623-02-emmc.dtb"
CONFIG_SYS_CONSOLE_IS_IN_ENV=y
CONFIG_DEFAULT_ENV_FILE="unielec_u7623-02_env"
CONFIG_BUTTON=y
CONFIG_BUTTON_GPIO=y
CONFIG_RESET_BUTTON_LABEL="factory"
CONFIG_CFB_CONSOLE_ANSI=y
CONFIG_CMD_ENV_FLAGS=y
# CONFIG_DISPLAY_BOARDINFO is not set
CONFIG_USE_DEFAULT_ENV_FILE=y
CONFIG_SYS_PROMPT="MT7623> "
CONFIG_SYS_MAXARGS=8
CONFIG_SYS_PBSIZE=1049
CONFIG_SYS_BOOTM_LEN=0x4000000
CONFIG_CMD_BOOTMENU=y
CONFIG_CMD_BOOTP=y
CONFIG_CMD_BOOTZ=y
CONFIG_CMD_BUTTON=y
CONFIG_CMD_CACHE=y
CONFIG_CMD_CDP=y
CONFIG_CMD_DHCP=y
CONFIG_CMD_DM=y
CONFIG_CMD_DNS=y
CONFIG_CMD_ECHO=y
CONFIG_CMD_ENV_READMEM=y
CONFIG_CMD_ERASEENV=y
CONFIG_CMD_EXT4=y
CONFIG_CMD_FAT=y
CONFIG_CMD_FS_GENERIC=y
CONFIG_CMD_FS_UUID=y
# CONFIG_CMD_ELF is not set
# CONFIG_CMD_XIMG is not set
CONFIG_CMD_GPIO=y
# CONFIG_CMD_GPT is not set
CONFIG_CMD_HASH=y
CONFIG_CMD_ITEST=y
CONFIG_CMD_LED=y
CONFIG_CMD_LICENSE=y
CONFIG_CMD_LINK_LOCAL=y
CONFIG_CMD_MBR=y
CONFIG_CMD_MMC=y
CONFIG_CMD_READ=y
CONFIG_CMD_SF_TEST=y
CONFIG_CMD_PING=y
CONFIG_CMD_PXE=y
CONFIG_CMD_TFTPBOOT=y
CONFIG_CMD_TFTPSRV=y
CONFIG_CMD_ASKENV=y
CONFIG_CMD_PART=y
CONFIG_CMD_RARP=y
CONFIG_CMD_SATA=y
CONFIG_CMD_SETEXPR=y
CONFIG_CMD_SLEEP=y
CONFIG_CMD_SNTP=y
CONFIG_CMD_SOURCE=y
CONFIG_CMD_STRINGS=y
CONFIG_CMD_USB=y
CONFIG_CMD_UUID=y
CONFIG_CMD_READ=y
CONFIG_CMD_SCSI=y
CONFIG_DISPLAY_CPUINFO=y
CONFIG_DM_ETH=y
CONFIG_DM_GPIO=y
CONFIG_DM_SCSI=y
CONFIG_DM_MMC=y
CONFIG_DM_REGULATOR=y
CONFIG_DM_REGULATOR_FIXED=y
CONFIG_DM_SERIAL=y
CONFIG_DM_REGULATOR_GPIO=y
CONFIG_DM_USB=y
CONFIG_DM_PCI=y
CONFIG_AHCI=y
CONFIG_AHCI_PCI=y
CONFIG_SCSI_AHCI=y
CONFIG_SCSI=y
CONFIG_HUSH_PARSER=y
CONFIG_ENV_IS_IN_MMC=y
CONFIG_SYS_RELOC_GD_ENV_ADDR=y
CONFIG_SYS_MMC_ENV_DEV=0
CONFIG_ENV_OVERWRITE=y
CONFIG_NET_RANDOM_ETHADDR=y
CONFIG_NETCONSOLE=y
CONFIG_USE_IPADDR=y
CONFIG_IPADDR="192.168.1.1"
CONFIG_USE_SERVERIP=y
CONFIG_SERVERIP="192.168.1.2"
CONFIG_REGMAP=y
CONFIG_SYSCON=y
CONFIG_CLK=y
# CONFIG_MMC_QUIRKS is not set
CONFIG_SUPPORT_EMMC_BOOT=y
CONFIG_MMC_HS400_SUPPORT=y
CONFIG_MMC_MTK=y
CONFIG_OF_LIBFDT_OVERLAY=y
CONFIG_PARTITION_UUIDS=y
CONFIG_PCI=y
CONFIG_PCIE_MEDIATEK=y
CONFIG_PHY=y
CONFIG_PHY_FIXED=y
CONFIG_MEDIATEK_ETH=y
CONFIG_PINCTRL=y
CONFIG_PINCONF=y
CONFIG_PINCTRL_MT7623=y
CONFIG_POWER_DOMAIN=y
CONFIG_MTK_POWER_DOMAIN=y
CONFIG_DM_SERIAL=y
CONFIG_MTK_SERIAL=y
CONFIG_RANDOM_UUID=y
CONFIG_REGEX=y
CONFIG_SYSRESET=y
CONFIG_SYSRESET_WATCHDOG=y
CONFIG_TIMER=y
CONFIG_MTK_TIMER=y
CONFIG_VERSION_VARIABLE=y
CONFIG_WDT_MTK=y
CONFIG_LZMA=y
```

## u-boot-mt/configs/mt7981_snfi_nand_rfb_defconfig
```kconfig
CONFIG_ARM=y
CONFIG_SYS_HAS_NONCACHED_MEMORY=y
CONFIG_POSITION_INDEPENDENT=y
CONFIG_ARCH_MEDIATEK=y
CONFIG_TEXT_BASE=0x41e00000
CONFIG_SYS_MALLOC_F_LEN=0x4000
CONFIG_NR_DRAM_BANKS=1
CONFIG_DEFAULT_DEVICE_TREE="mt7981-snfi-nand-rfb"
CONFIG_SYS_PROMPT="MT7981> "
CONFIG_TARGET_MT7981=y
CONFIG_DEBUG_UART_BASE=0x11002000
CONFIG_DEBUG_UART_CLOCK=40000000
CONFIG_SYS_LOAD_ADDR=0x46000000
CONFIG_DEBUG_UART=y
CONFIG_OF_LIBFDT_OVERLAY=y
CONFIG_SMBIOS_PRODUCT_NAME=""
CONFIG_CFB_CONSOLE_ANSI=y
CONFIG_BOARD_LATE_INIT=y
CONFIG_BUTTON=y
CONFIG_BUTTON_GPIO=y
CONFIG_GPIO_HOG=y
CONFIG_CMD_ENV_FLAGS=y
CONFIG_FIT=y
CONFIG_FIT_ENABLE_SHA256_SUPPORT=y
CONFIG_LED=y
CONFIG_LED_BLINK=y
CONFIG_LED_GPIO=y
CONFIG_SPI_BOOT=y
CONFIG_NAND_BOOT=y
CONFIG_BOOTSTD_DEFAULTS=y
CONFIG_BOOTSTD_FULL=y
CONFIG_DEFAULT_FDT_FILE="mt7981-snfi-nand-rfb"
CONFIG_LOGLEVEL=7
CONFIG_LOG=y
CONFIG_SYS_CBSIZE=512
CONFIG_SYS_PBSIZE=1049
# CONFIG_BOOTM_NETBSD is not set
# CONFIG_BOOTM_PLAN9 is not set
# CONFIG_BOOTM_RTEMS is not set
# CONFIG_BOOTM_VXWORKS is not set
# CONFIG_CMD_UNLZ4 is not set
# CONFIG_CMD_UNZIP is not set
CONFIG_CMD_BOOTMENU=y
CONFIG_CMD_BOOTP=y
CONFIG_CMD_BUTTON=y
CONFIG_CMD_CACHE=y
CONFIG_CMD_CDP=y
CONFIG_CMD_CPU=y
CONFIG_CMD_DHCP=y
CONFIG_CMD_DM=y
CONFIG_CMD_ELF=y
CONFIG_CMD_DNS=y
CONFIG_CMD_ECHO=y
CONFIG_CMD_ENV_READMEM=y
CONFIG_CMD_ERASEENV=y
CONFIG_CMD_FDT=y
CONFIG_CMD_FS_GENERIC=y
CONFIG_CMD_FS_UUID=y
CONFIG_CMD_GPIO=y
CONFIG_CMD_MTD=y
CONFIG_CMD_HASH=y
CONFIG_CMD_ITEST=y
CONFIG_CMD_LED=y
CONFIG_CMD_LICENSE=y
CONFIG_CMD_LINK_LOCAL=y
CONFIG_CMD_MTD=y
CONFIG_CMD_NAND=y
# CONFIG_MTD_RAW_NAND is not set
CONFIG_CMD_NAND_TRIMFFS=y
CONFIG_CMD_PCI=y
CONFIG_CMD_PSTORE=y
CONFIG_CMD_PSTORE_MEM_ADDR=0x42ff0000
CONFIG_CMD_SF=y
CONFIG_CMD_SF_TEST=y
CONFIG_CMD_PING=y
CONFIG_CMD_PXE=y
CONFIG_CMD_SMC=y
CONFIG_CMD_UBI=y
CONFIG_CMD_UBI_RENAME=y
CONFIG_CMD_UBIFS=y
CONFIG_CMD_TFTPBOOT=y
CONFIG_CMD_TFTPSRV=y
CONFIG_CMD_ASKENV=y
CONFIG_CMD_RARP=y
CONFIG_CMD_SETEXPR=y
CONFIG_CMD_SLEEP=y
CONFIG_CMD_SNTP=y
CONFIG_CMD_SOURCE=y
CONFIG_CMD_STRINGS=y
CONFIG_CMD_UUID=y
CONFIG_ENV_OVERWRITE=y
CONFIG_ENV_IS_IN_UBI=y
CONFIG_ENV_UBI_PART="ubi"
CONFIG_ENV_SIZE=0x1f000
CONFIG_ENV_SIZE_REDUND=0x1f000
CONFIG_ENV_UBI_VOLUME="ubootenv"
CONFIG_ENV_UBI_VOLUME_REDUND="ubootenv2"
CONFIG_ENV_VARS_UBOOT_RUNTIME_CONFIG=y
CONFIG_NET_RANDOM_ETHADDR=y
CONFIG_REGEX=y
CONFIG_REGMAP=y
CONFIG_SYSCON=y
CONFIG_CLK=y
# CONFIG_MMC is not set
CONFIG_HUSH_PARSER=y
CONFIG_SYS_REDUNDAND_ENVIRONMENT=y
CONFIG_SYS_RELOC_GD_ENV_ADDR=y
CONFIG_MTD=y
CONFIG_DM_MTD=y
CONFIG_MTK_SPI_NAND=y
CONFIG_MTK_SPI_NAND_MTD=y
CONFIG_PHY_FIXED=y
CONFIG_MEDIATEK_ETH=y
CONFIG_PINCTRL=y
CONFIG_PINCONF=y
CONFIG_PINCTRL_MT7981=y
CONFIG_POWER_DOMAIN=y
CONFIG_MTK_POWER_DOMAIN=y
CONFIG_DM_SERIAL=y
CONFIG_MTK_SERIAL=y
CONFIG_HEXDUMP=y
CONFIG_LMB_MAX_REGIONS=64
```

## u-boot-mt/configs/mt7986a_glinet_gl-mt6000_defconfig
```kconfig
CONFIG_ARM=y
CONFIG_SYS_HAS_NONCACHED_MEMORY=y
CONFIG_POSITION_INDEPENDENT=y
CONFIG_ARCH_MEDIATEK=y
CONFIG_TEXT_BASE=0x41e00000
CONFIG_SYS_MALLOC_F_LEN=0x4000
CONFIG_NR_DRAM_BANKS=1
CONFIG_ENV_SIZE=0x80000
CONFIG_ENV_OFFSET=0x400000
CONFIG_DEFAULT_DEVICE_TREE="mt7986a-glinet-gl-mt6000"
CONFIG_SYS_PROMPT="MT7986> "
CONFIG_OF_LIBFDT_OVERLAY=y
CONFIG_TARGET_MT7986=y
CONFIG_PRE_CON_BUF_ADDR=0x4007EF00
CONFIG_DEBUG_UART_BASE=0x11002000
CONFIG_DEBUG_UART_CLOCK=40000000
CONFIG_SYS_LOAD_ADDR=0x46000000
CONFIG_DEBUG_UART=y
CONFIG_AHCI=y
CONFIG_FIT=y
CONFIG_AUTOBOOT_KEYED=y
CONFIG_AUTOBOOT_MENU_SHOW=y
CONFIG_DEFAULT_FDT_FILE="mediatek/mt7986a-glinet-gl-mt6000.dtb"
CONFIG_LOGLEVEL=7
CONFIG_PRE_CONSOLE_BUFFER=y
CONFIG_LOG=y
CONFIG_BOARD_LATE_INIT=y
CONFIG_HUSH_PARSER=y
CONFIG_CMD_CPU=y
CONFIG_CMD_LICENSE=y
CONFIG_CMD_BOOTMENU=y
CONFIG_CMD_ASKENV=y
CONFIG_CMD_ERASEENV=y
CONFIG_CMD_ENV_FLAGS=y
CONFIG_CMD_STRINGS=y
CONFIG_CMD_DM=y
CONFIG_CMD_GPIO=y
CONFIG_CMD_PWM=y
CONFIG_CMD_GPT=y
CONFIG_CMD_MMC=y
CONFIG_CMD_PART=y
CONFIG_CMD_USB=y
CONFIG_CMD_DHCP=y
CONFIG_CMD_TFTPSRV=y
CONFIG_CMD_RARP=y
CONFIG_CMD_PING=y
CONFIG_CMD_CDP=y
CONFIG_CMD_SNTP=y
CONFIG_CMD_DNS=y
CONFIG_CMD_LINK_LOCAL=y
CONFIG_CMD_CACHE=y
CONFIG_CMD_PSTORE=y
CONFIG_CMD_PSTORE_MEM_ADDR=0x42ff0000
CONFIG_CMD_UUID=y
CONFIG_CMD_HASH=y
CONFIG_CMD_SMC=y
CONFIG_OF_EMBED=y
CONFIG_ENV_OVERWRITE=y
CONFIG_ENV_IS_IN_MMC=y
CONFIG_SYS_RELOC_GD_ENV_ADDR=y
CONFIG_USE_DEFAULT_ENV_FILE=y
CONFIG_DEFAULT_ENV_FILE="glinet_gl-mt6000_env"
CONFIG_ENV_VARS_UBOOT_RUNTIME_CONFIG=y
CONFIG_VERSION_VARIABLE=y
CONFIG_NET_RANDOM_ETHADDR=y
CONFIG_NETCONSOLE=y
CONFIG_USE_IPADDR=y
CONFIG_IPADDR="192.168.1.1"
CONFIG_USE_SERVERIP=y
CONFIG_SERVERIP="192.168.1.254"
CONFIG_REGMAP=y
CONFIG_SYSCON=y
CONFIG_BUTTON=y
CONFIG_BUTTON_GPIO=y
CONFIG_CLK=y
CONFIG_GPIO_HOG=y
CONFIG_LED=y
CONFIG_LED_BLINK=y
CONFIG_LED_GPIO=y
CONFIG_SUPPORT_EMMC_BOOT=y
CONFIG_MMC_HS200_SUPPORT=y
CONFIG_MMC_MTK=y
CONFIG_PHY_FIXED=y
CONFIG_MEDIATEK_ETH=y
CONFIG_PHY=y
CONFIG_PHY_MTK_TPHY=y
CONFIG_PINCTRL=y
CONFIG_PINCONF=y
CONFIG_PINCTRL_MT7986=y
CONFIG_POWER_DOMAIN=y
CONFIG_MTK_POWER_DOMAIN=y
CONFIG_DM_REGULATOR=y
CONFIG_DM_REGULATOR_FIXED=y
CONFIG_DM_REGULATOR_GPIO=y
CONFIG_DM_PWM=y
CONFIG_PWM_MTK=y
CONFIG_RAM=y
CONFIG_DM_SERIAL=y
CONFIG_MTK_SERIAL=y
CONFIG_USB=y
CONFIG_USB_XHCI_HCD=y
CONFIG_USB_XHCI_MTK=y
CONFIG_USB_STORAGE=y
CONFIG_HEXDUMP=y
CONFIG_LMB_MAX_REGIONS=64
```
